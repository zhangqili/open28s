/*
 * Copyright (c) 2024 Zhangqi Li (@zhangqili)
 *
 * SPDX-License-Identifier: GPL-3.0-or-later
 */
#include "keyboard.h"
#include "rgb.h"
#include "main.h"
#include "string.h"
#include "usbd_user.h"
#include "analog.h"
#include "qmk_midi.h"
#include "gamepad.h"

const Keycode g_default_keymap[LAYER_NUM][TOTAL_KEY_NUM] = {
    {
        KEYCODE(GAMEPAD_COLLECTION, GAMEPAD_UP)/*0*/,           KEYCODE(GAMEPAD_COLLECTION, GAMEPAD_RIGHT)/*1*/,     KEYCODE(GAMEPAD_COLLECTION, GAMEPAD_DOWN)/*2*/,     KEYCODE(GAMEPAD_COLLECTION, GAMEPAD_A)/*3*/,     KEY_NO_EVENT/*4*/,     KEY_NO_EVENT/*5*/,     KEYCODE(GAMEPAD_COLLECTION, GAMEPAD_B)/*6*/,     KEYCODE(GAMEPAD_COLLECTION, GAMEPAD_LB)/*7*/,     KEYCODE(GAMEPAD_COLLECTION, GAMEPAD_RT)/*8*/,     KEYCODE(GAMEPAD_COLLECTION, GAMEPAD_LEFT)/*9*/,     KEY_NO_EVENT/*10*/,        KEYCODE(GAMEPAD_COLLECTION, GAMEPAD_X)/*11*/,        KEY_NO_EVENT/*12*/,        KEY_NO_EVENT/*13*/,
        KEYCODE(GAMEPAD_COLLECTION, GAMEPAD_Y)/*14*/,          KEYCODE(GAMEPAD_COLLECTION, GAMEPAD_RB)/*15*/,    KEYCODE(GAMEPAD_COLLECTION, GAMEPAD_LT)/*16*/,    
        KEYCODE(GAMEPAD_COLLECTION, GAMEPAD_LS)/*17*/,    KEYCODE(GAMEPAD_COLLECTION, GAMEPAD_RS)/*18*/,    KEYCODE(GAMEPAD_COLLECTION, GAMEPAD_START)/*19*/,    KEYCODE(GAMEPAD_COLLECTION, GAMEPAD_BACK)/*20*/,    
        KEY_NO_EVENT/*21*/,    KEY_NO_EVENT/*22*/,    KEY_NO_EVENT/*23*/,    KEY_NO_EVENT/*24*/,        KEY_NO_EVENT/*25*/,   },
    {
        KEY_TRANSPARENT,        KEY_TRANSPARENT,KEY_TRANSPARENT,KEY_TRANSPARENT,KEY_TRANSPARENT,KEY_TRANSPARENT,KEY_TRANSPARENT,KEY_TRANSPARENT,KEY_TRANSPARENT,KEY_TRANSPARENT,KEY_TRANSPARENT,KEY_TRANSPARENT,KEY_TRANSPARENT,KEY_TRANSPARENT,
        KEY_TRANSPARENT,        KEY_TRANSPARENT,KEY_TRANSPARENT,KEY_TRANSPARENT,KEY_TRANSPARENT,KEY_TRANSPARENT,KEY_TRANSPARENT,KEY_TRANSPARENT,KEY_TRANSPARENT,KEY_TRANSPARENT,KEY_TRANSPARENT,KEY_TRANSPARENT,           },
    {
        KEY_TRANSPARENT,        KEY_TRANSPARENT,KEY_TRANSPARENT,KEY_TRANSPARENT,KEY_TRANSPARENT,KEY_TRANSPARENT,KEY_TRANSPARENT,KEY_TRANSPARENT,KEY_TRANSPARENT,KEY_TRANSPARENT,KEY_TRANSPARENT,KEY_TRANSPARENT,KEY_TRANSPARENT,KEY_TRANSPARENT,
        KEY_TRANSPARENT,        KEY_TRANSPARENT,KEY_TRANSPARENT,KEY_TRANSPARENT,KEY_TRANSPARENT,KEY_TRANSPARENT,KEY_TRANSPARENT,KEY_TRANSPARENT,KEY_TRANSPARENT,KEY_TRANSPARENT,KEY_TRANSPARENT,KEY_TRANSPARENT,           },

};

const uint16_t g_analog_map[ADVANCED_KEY_NUM] =
{
    0,1,2,3,4,5,6,7,8,9,10,11,12,13,14,15,16
};

const uint16_t table[LUT_LENGTH] = {
        0,    59,   118,   176,   235,   294,   352,   411,   469,   528,   586,   644,   703,   761,   819,   877, // 0 ~ 7
      935,   993,  1051,  1109,  1167,  1225,  1283,  1340,  1398,  1455,  1513,  1571,  1628,  1685,  1743,  1800, // 16 ~ 23
     1857,  1914,  1972,  2029,  2086,  2143,  2200,  2256,  2313,  2370,  2427,  2484,  2540,  2597,  2653,  2710, // 32 ~ 39
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    65258, 65276, 65295, 65314, 65332, 65350, 65369, 65387, 65406, 65424, 65443, 65461, 65480, 65498, 65517, 65535 // 2032 ~ 2039
};



AnalogValue advanced_key_normalize(AdvancedKey* advanced_key, AnalogRawValue value)
{
    const uint16_t length = sizeof(table) / sizeof(table[0]);
    int32_t delta = (advanced_key->config.upper_bound - value);
    int16_t index = ((delta * advanced_key->q_scale_to_index) >> 16);
    if (index < 0)
    {
        index = 0;
    }
    if (index >= length)
    {
        index = length - 1;
    }
    return table[index] + ANALOG_VALUE_MIN;
    /*
    if (x<0.225)
    {
        return x*(0.5/0.225);
    }
    else if (x<0.404)
    {
        return (x-0.225)*(0.25/(0.404-0.225))+0.5;
    }
    else
    {
        return (x-0.404)*(0.25/(1.0-0.404))+0.75;
    }
    */
    
}

void keyboard_scan()
{
    keyboard_key_update(&g_keyboard_keys[0], !HAL_GPIO_ReadPin(KEY_1_GPIO_Port, KEY_1_Pin));
    keyboard_key_update(&g_keyboard_keys[1], !HAL_GPIO_ReadPin(KEY_2_GPIO_Port, KEY_2_Pin));
    keyboard_key_update(&g_keyboard_keys[2], !HAL_GPIO_ReadPin(KEY_3_GPIO_Port, KEY_3_Pin));
    keyboard_key_update(&g_keyboard_keys[3], !HAL_GPIO_ReadPin(KEY_4_GPIO_Port, KEY_4_Pin));
    keyboard_key_update(&g_keyboard_keys[4], !HAL_GPIO_ReadPin(KEY_5_GPIO_Port, KEY_5_Pin));
    keyboard_key_update(&g_keyboard_keys[5], !HAL_GPIO_ReadPin(KEY_RIGHT_GPIO_Port, KEY_RIGHT_Pin));
    keyboard_key_update(&g_keyboard_keys[6], !HAL_GPIO_ReadPin(KEY_LEFT_GPIO_Port, KEY_LEFT_Pin));
    keyboard_key_update(&g_keyboard_keys[7], !HAL_GPIO_ReadPin(KEY_DOWN_GPIO_Port, KEY_DOWN_Pin));
    keyboard_key_update(&g_keyboard_keys[8], !HAL_GPIO_ReadPin(KEY_UP_GPIO_Port, KEY_UP_Pin));
}

void keyboard_delay(uint32_t ms)
{
    HAL_Delay(ms);
}

void keyboard_reboot()
{
    __set_FAULTMASK(1);
    NVIC_SystemReset();
}

void keyboard_jump_to_bootloader(void)
{
    
}

#define FLASH_BASE_ADDR      0x08000000
#define FLASH_PAGE_SIZE      1024
#define FLASH_SIZE           (64*FLASH_PAGE_SIZE)
#define LFS_FLASH_BASE_ADDR  (FLASH_BASE_ADDR + FLASH_SIZE - LFS_BLOCK_COUNT*FLASH_PAGE_SIZE)

int flash_read(uint32_t addr, uint32_t size, uint8_t *data)
{
    uint32_t physical_addr = LFS_FLASH_BASE_ADDR + addr;
    memcpy(data, (void *)physical_addr, size);
    return 0;
}

int flash_write(uint32_t addr, uint32_t size, const uint8_t *data)
{
    uint32_t physical_addr = LFS_FLASH_BASE_ADDR + addr;
    HAL_StatusTypeDef status = HAL_OK;
    HAL_FLASH_Unlock();
    for (uint32_t i = 0; i < size; i += 4)
    {
        uint32_t word_data;
        memcpy(&word_data, &data[i], 4);
        status = HAL_FLASH_Program(FLASH_TYPEPROGRAM_WORD, physical_addr + i, word_data);
        if (status != HAL_OK)
        {
            break;
        }
    }
    HAL_FLASH_Lock();
    return (status == HAL_OK) ? 0 : -5;
}

int flash_erase(uint32_t addr, uint32_t size)
{
    uint32_t physical_addr = LFS_FLASH_BASE_ADDR + addr;
    HAL_StatusTypeDef status = HAL_OK;
    FLASH_EraseInitTypeDef EraseInitStruct;
    uint32_t PageError = 0;
    uint32_t nb_pages = size / FLASH_PAGE_SIZE;
    if (size % FLASH_PAGE_SIZE != 0) {
        nb_pages++;
    }
    EraseInitStruct.TypeErase   = FLASH_TYPEERASE_PAGES;
    EraseInitStruct.PageAddress = physical_addr;
    EraseInitStruct.NbPages     = nb_pages;
    HAL_FLASH_Unlock();
    status = HAL_FLASHEx_Erase(&EraseInitStruct, &PageError);
    HAL_FLASH_Lock();
    return (status == HAL_OK) ? 0 : -5;
}
